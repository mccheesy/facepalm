## config/west.yml
```yaml
manifest:
  remotes:
    - name: zmkfirmware
      url-base: https://github.com/zmkfirmware

    - name: azumafuji
      url-base: https://github.com/azumafuji

    - name: caksoylar
      url-base: https://github.com/dhruvinsh

    - name: m165437
      url-base: https://github.com/M165437

    - name: mctechnology17
      url-base: https://github.com/mctechnology17/

    - name: urob
      url-base: https://github.com/urob

  projects:
    - name: zmk
      remote: zmkfirmware
      revision: main
      import: app/west.yml

    - name: zmk-auto-layer
      remote: urob
      revision: main

    - name: zmk-nice-oled
      remote: mctechnology17
      revision: main

    - name: zmk-tri-state
      remote: urob
      revision: main

    - name: nice-view-gem
      remote: m165437
      revision: main

    - name: totem-yads
      remote: azumafuji
      revision: main

  self:
    path: config
```
